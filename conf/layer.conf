## conf/layer.conf
```bitbake
# Append conf dir to BBPATH
BBPATH .= ":${LAYERDIR}"

# Append recipe dir to BBFILES
BBFILES += "${LAYERDIR}/recipes*/*/*.bb ${LAYERDIR}/recipes*/*/*.bbappend"

LAYERSERIES_COMPAT_buildkite = "rocko sumo thud warrior"

BBFILE_COLLECTIONS += "buildkite"
BBFILE_PRIORITY_buildkite = "1"
BBFILE_PATTERN_buildkite = "${LAYERDIR}"
```
